## Kconfig
```kconfig
mainmenu "Maix-Speech configuration"

menu "Toolchain configuration"
	config TOOLCHAIN_PATH
		string "toolchain path"
		default ""
	
	config TOOLCHAIN_PREFIX
		string "toolchain prefix"
		default ""
endmenu

choice ARCH
	prompt "CPU arch"
	default ARCH_X86
	help
		"Select CPU arch"

	config ARCH_X86
		bool "x86 (Linux)"

	config ARCH_R329
		bool "r329 (AIPU)"

	config ARCH_RISCV64
		bool "riscv64 (D1)"

	config ARCH_AARCH64
		bool "aarch64 (r329)"

	config ARCH_ARMV7MUSL
		bool "armv7musl (v83x)"

	config ARCH_ARMV7
		bool "armv7 (Raspberry Pi 32bit)"

	config ARCH_V83X
		bool "v83x (v831/v833 AWNN)"

endchoice

menu "Components configuration"
	osource "${SDK_PATH}/components/*/Kconfig"
	osource "${PROJECT_PATH}/*/Kconfig"
endmenu
```
